## boards/gello-usb.conf
```kconfig
CONFIG_ROBOT_GELLO_UART=n
CONFIG_ROBOT_GELLO_USB=y
CONFIG_USBH_STACK_SIZE=3072
CONFIG_USBH_MAX_UHC_MSG=32
CONFIG_UHC_BUF_POOL_SIZE=4096
CONFIG_USBH_USB_DEVICE_HEAP=2048
CONFIG_THREAD_NAME=y
CONFIG_THREAD_MONITOR=y
```

## boards/right.conf
```kconfig
# Node 11: new arm + P1L; node 12: original arm + P1L.
CONFIG_NET_CONFIG_MY_IPV4_ADDR="192.168.10.12"
CONFIG_NET_CONFIG_PEER_IPV4_ADDR="192.168.10.1"
CONFIG_ROBOT_NODE_ID=12
CONFIG_ROBOT_HOST_NODE_ID=10
CONFIG_ROBOT_RT_PORT=5015
CONFIG_ROBOT_MGMT_PORT=5016
CONFIG_ROBOT_PEER_NODE_ID=11
CONFIG_ROBOT_PEER_IPV4_ADDR="192.168.10.11"
CONFIG_ROBOT_LOCAL_ACTUATORS=y

CONFIG_ROBOT_LOCAL_HOME=y
CONFIG_ROBOT_BOOT_HOME=y
CONFIG_ROBOT_GELLO_UART=n
CONFIG_ROBOT_GELLO_USB=y
```
